## drivers/hdmi/Kconfig
```kconfig
menuconfig HDMI
	bool "High Definition Multimedia Interface (HDMI) Support"

if HDMI

config HDMI_SII902x
	tristate "Silicon Image sii902x HDMI support"
	select REGMAP_I2C

config SND_SOC_SII9022
	tristate "Enable Audio support on Sii902x"
	depends on HDMI_SII902x && SND_SOC

endif
```

## sound/soc/generic/Kconfig
```kconfig
config SND_SIMPLE_CARD
	tristate "ASoC Simple sound card support"
	select SND_SOC_DMIC
	help
	  This option enables generic simple sound card support
```
